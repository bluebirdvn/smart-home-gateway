## yocto/meta-ble-mesh/conf/layer.conf
```bitbake
BBPATH .= ":${LAYERDIR}"

BBFILES += "${LAYERDIR}/recipes-*/*/*.bb \
            ${LAYERDIR}/recipes-*/*/*.bbappend \
            ${LAYERDIR}/recipes-*/*/*/*.bb \
            ${LAYERDIR}/recipes-*/*/*/*.bbappend"

BBFILE_COLLECTIONS += "meta-ble-mesh"
BBFILE_PATTERN_meta-ble-mesh = "^${LAYERDIR}/"
BBFILE_PRIORITY_meta-ble-mesh = "6"

LAYERDEPENDS_meta-ble-mesh = "core"
LAYERSERIES_COMPAT_meta-ble-mesh = "scarthgap"
```
